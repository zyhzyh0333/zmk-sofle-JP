## config/Kconfig
```kconfig
#
# Copyright (c) 2022 The ZMK Contributors
# SPDX-License-Identifier: MIT
#

config BOARD_SOFLE_LEFT
    bool

config BOARD_SOFLE_RIGHT
    bool

config BOARD_ENABLE_DCDC
    bool "Enable DCDC mode"
    select SOC_DCDC_NRF52X
    default y
    depends on BOARD_sofle
```

## config/boards/arm/sofle/Kconfig.board
```kconfig
#
# Copyright (c) 2022 Darryl deHaan
# SPDX-License-Identifier: MIT
#

config BOARD_SOFLE_LEFT
    bool "sofle left"
    depends on SOC_NRF52840_QIAA


config BOARD_SOFLE_RIGHT
    bool "sofle right"
    depends on SOC_NRF52840_QIAA

config BOARD_ENABLE_DCDC
    bool "Enable DCDC mode"
    select SOC_DCDC_NRF52X
    default y
    depends on BOARD_sofle
```
